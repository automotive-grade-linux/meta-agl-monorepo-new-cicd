## layers/meta-agl-devel/meta-agl-ic-container/files/wic/agl-ic-container-rockchip-demo.wks
```
# short-description: Single partition rootfs with UUID and no bootloader
# long-description: Creates a partitioned image with a single partition in
# use and does not contain a bootloader.

bootloader --ptable gpt
part loader1   --offset 64s    --fixed-size 3552K --fstype=none --part-name loader1   --source rawcopy --sourceparams="file=${SPL_BINARY}"
part v_storage --offset 7168s  --fixed-size 256K  --fstype=none --part-name v_storage
part reserved  --offset 7680s  --fixed-size 192K  --fstype=none --part-name reserved
part reserved1 --offset 8064s  --fixed-size 32K   --fstype=none --part-name reserved1
part uboot_env --offset 8128s  --fixed-size 32K   --fstype=none --part-name uboot_env ${RK_UBOOT_ENV}
part reserved2 --offset 8192s  --fixed-size 4096K --fstype=none --part-name reserved2
part loader2   --offset 16384s --fixed-size 4096K --fstype=none --part-name loader2   --source rawcopy --sourceparams="file=u-boot.${UBOOT_SUFFIX}"
part atf       --offset 24576s --fixed-size 4096K --fstype=none --part-name atf
part /         --label rootfsA --active           --fstype=ext4 --part-name rootfsA   --source rootfs  --part-type ${ROOT_DPS}
part --source rawcopy --sourceparams="file=guest-image-cluster-demo.ext4"
part --source rawcopy --sourceparams="file=guest-image-ivi-demo.ext4"
part --source rawcopy --sourceparams="file=agl-ivi-demo-qt.ext4"
part --source rawcopy --sourceparams="file=agl-ivi-demo-flutter.ext4"
```

## meta-agl-bsp/conf/machine/include/virtio.inc
```bitbake
PREFERRED_PROVIDER_virtual/egl ?= "mesa"
PREFERRED_PROVIDER_virtual/libgl ?= "mesa"
PREFERRED_PROVIDER_virtual/libgles1 ?= "mesa"
PREFERRED_PROVIDER_virtual/libgles2 ?= "mesa"

MACHINE_FEATURES = "alsa usbgadget screen vfat"

MACHINEOVERRIDES =. "virtio-all:"

IMAGE_FSTYPES += "tar.bz2 ext4"

# Don't include kernels in standard images
RDEPENDS_${KERNEL_PACKAGE_NAME}-base = ""

# Use a common kernel recipe for all VirtIO machines
PREFERRED_PROVIDER_virtual/kernel ??= "linux-yocto"

# Use newer kernel
PREFERRED_VERSION_linux-yocto = "5.10.%"

# Clear since it is set to 'sllin' in packagegroup-agl-demo.bb, and sllin is not
# compatible with kernel 5.10 at the moment.
LIN_DRIVERS = ""

# Clear since it is set to 'lttng-modules' in packagegroup-core-tools-profile.bb,
# and lttng-modules are not compatible with 5.10 kernel used for virtio.
LTTNGMODULES_virtio-all = ""

EXTRA_IMAGEDEPENDS += "qemu-native qemu-helper-native"

IMAGE_CLASSES += "qemuboot"

# most driver fails to compile
MOST_DRIVERS ?= ""
```

## meta-agl-core-test/conf/layer.conf
```bitbake
# We have a conf and classes directory, add to BBPATH
BBPATH =. "${LAYERDIR}:"

# We have recipes-* directories, add to BBFILES
BBFILES += "${LAYERDIR}/recipes-*/*/*.bb \
            ${LAYERDIR}/recipes-*/*/*.bbappend"

BBFILE_COLLECTIONS += "aglcoretest"
BBFILE_PATTERN_aglcoretest = "^${LAYERDIR}/"
BBFILE_PRIORITY_aglcoretest = "60"

LAYERSERIES_COMPAT_aglcoretest = "dunfell"
LAYERDEPENDS_aglcoretest = "core aglcore"
LAYERDEPENDS_aglcoretest += "openembedded-layer"
```

## meta-agl-core/conf/distro/agl.conf
```bitbake
# AGL specific derivations
DISTRO = "agl"
DISTRO_NAME = "Automotive Grade Linux"
DISTRO_VERSION := "${AGLVERSION}"
DISTRO_BRANCH_VERSION_TAG = "${DISTRO_CODENAME}/${DISTRO_VERSION}"
MAINTAINER = "AGL https://lists.automotivelinux.org/g/agl-dev-community"
TARGET_VENDOR = "-agl"

# Release flags
DISTRO_CODENAME = "unagi"
AGL_BRANCH = "master"
AGLVERSION = "20.90.0"

# Insert overrides "agldefaulttune" and "forcedefaulttune" before forcevariable
OVERRIDES = "${TARGET_OS}:${TRANSLATED_TARGET_ARCH}:pn-${PN}:${MACHINEOVERRIDES}:${DISTROOVERRIDES}:${CLASSOVERRIDE}${LIBCOVERRIDE}:agldefaulttune:forcedefaulttune:forcevariable"
OVERRIDES .= ":${DISTRO_CODENAME}"

# Default includes
require conf/distro/include/no-static-libs.inc
require conf/distro/include/yocto-uninative.inc
require conf/distro/include/security_flags.inc

# Default inherits, default folders
INHERIT += "create-spdx uninative"
TCLIBCAPPEND = ""

# Architecture / CPU specific choices
# AGL uses 4 optimization levels
# 2 for ARM 32bit
#   - a high and a medium setting for the CCARGS
#   - the high setting is default (needs >= cortex-a15)
#   - the medium setting is enabled with: DISTRO_FEATURES:append = " agl-medium-arm-compiler "
# 1 for ARM 64bit / AARCH64
# 1 for x86-64
# 1 for RISC-V 64-bit
require conf/distro/include/${TARGET_ARCH}-tune.inc


# reproducible builds:
# Set the desired timestamps
# E.g. update for (major) releases
export SOURCE_DATE_EPOCH = "1752134164"
REPRODUCIBLE_TIMESTAMP_ROOTFS = "1752134164"

# SDK
SDK_VENDOR = "-aglsdk"

# SDKPATHINSTALL is the folder where the SDK is going to be installed
# Due to an issue with the qt5 environment (see SPEC-1667),
# we add DEFAULTTUNE to the SDKPATH to mitigate the issue.
SDK_VERSION = "${DISTRO_VERSION}"
SDK_NAME = "${DISTRO}-${TCLIBC}-${SDKMACHINE}-${IMAGE_BASENAME}-${TUNE_PKGARCH}-${MACHINE}"
SDKPATHINSTALL = "/opt/agl-sdk/${SDK_VERSION}-${DEFAULTTUNE}"


# Specific overrides compare to default configuration
AGL_DEFAULT_DISTRO_FEATURES = "usrmerge largefile opengl wayland pam bluetooth bluez5 3g polkit"
DISTRO_FEATURES := "${DISTRO_FEATURES_DEFAULT} ${AGL_DEFAULT_DISTRO_FEATURES}"
DISTRO_FEATURES:remove = "x11"
DISTRO_FEATURES_BACKFILL_CONSIDERED = "pulseaudio"

# basic userspace
DISTRO_EXTRA_RDEPENDS = " packagegroup-agl-core-boot"

# basic kernel settings
PREFERRED_VERSION_linux-yocto = "6.6%"
PREFERRED_VERSION_linux-yocto-rt = "6.6%"
KERNEL_EXTRA_FEATURES = " features/debug/debug-kernel.scc"

# init manager
INIT_MANAGER = "systemd"
# Override default of "systemd-compat-units"
VIRTUAL-RUNTIME_initscripts = ""
# Override default of "busybox-syslog"
VIRTUAL-RUNTIME_base-utils-syslog = ""
# network manager to use (possible values: systemd, connman)
VIRTUAL-RUNTIME_net_manager ?= "connman"

# QEMU
QEMU_TARGETS ?= "arm aarch64 i386 x86_64 riscv64"
# Other QEMU_TARGETS "mips mips64 mips64el ppc sh4"
# Generic qemu and qemuboot (runqemu) enhancements
# check qemuboot.bbclass
# - use 2G RAM by default
QB_MEM ?= "-m 2048"
# use pulseaudio on the host side - off as qemu-native is built with alsa
#QB_AUDIO_DRV = "pa"
# expose a virtual 'hda' sound card to the guest (arm/aarch64/x86-64)
QB_AUDIO_OPT = "-device intel-hda -device hda-duplex -audiodev alsa,id=agl"


# MIRROR
MIRRORS =+ "\
bzr://.*/.*      https://download.automotivelinux.org/AGL/mirror/ \n \
cvs://.*/.*      https://download.automotivelinux.org/AGL/mirror/ \n \
git://.*/.*      https://download.automotivelinux.org/AGL/mirror/ \n \
gitsm://.*/.*    https://download.automotivelinux.org/AGL/mirror/ \n \
hg://.*/.*       https://download.automotivelinux.org/AGL/mirror/ \n \
osc://.*/.*      https://download.automotivelinux.org/AGL/mirror/ \n \
p4://.*/.*       https://download.automotivelinux.org/AGL/mirror/ \n \
svn://.*/.*      https://download.automotivelinux.org/AGL/mirror/ \n \
bzr://.*/.*      http://download.automotivelinux.org/AGL/mirror/  \n \
cvs://.*/.*      http://download.automotivelinux.org/AGL/mirror/  \n \
git://.*/.*      http://download.automotivelinux.org/AGL/mirror/  \n \
gitsm://.*/.*    http://download.automotivelinux.org/AGL/mirror/  \n \
hg://.*/.*       http://download.automotivelinux.org/AGL/mirror/  \n \
osc://.*/.*      http://download.automotivelinux.org/AGL/mirror/  \n \
p4://.*/.*       http://download.automotivelinux.org/AGL/mirror/  \n \
svn://.*/.*      http://download.automotivelinux.org/AGL/mirror/  \n \
                 \
ftp://.*/.*      https://download.automotivelinux.org/AGL/mirror/ \n \
http://.*/.*     https://download.automotivelinux.org/AGL/mirror/ \n \
https://.*/.*    https://download.automotivelinux.org/AGL/mirror/ \n \
ftp://.*/.*      http://download.automotivelinux.org/AGL/mirror/  \n \
http://.*/.*     http://download.automotivelinux.org/AGL/mirror/  \n \
https://.*/.*    http://download.automotivelinux.org/AGL/mirror/  \n \
"

# Hashserve
BB_HASHSERVE ?= "auto"
BB_SIGNATURE_HANDLER = "OEEquivHash"

# PRSERV

# SSTATE_MIRROR

# The CONNECTIVITY_CHECK_URI's are used to test whether we can succesfully
# fetch from the network (and warn you if not). To disable the test set
# the variable to be empty.
# Git example url: git://git.yoctoproject.org/yocto-firewall-test;protocol=git;rev=HEAD
CONNECTIVITY_CHECK_URIS ?= ""

# using multiple BSP layers causes dangling bbappends in meta-agl-bsp
# turn it into a warning
#BB_DANGLINGAPPENDS_WARNONLY = "1"

# Not yet upstreamed; should be submitted.
SECURITY_CFLAGS:pn-qtwebengine = "${SECURITY_NO_PIE_CFLAGS}"


# Board templates can add extra IMAGE_FSTYPES through this.
# It is added (late) through the AGL image recipes.
AGL_EXTRA_IMAGE_FSTYPES ??= ""
AGL_EXTRA_INITRAMFS_FSTYPES ??= ""
#
# Default IMAGE FSTYPES wic.xz
AGL_DEFAULT_IMAGE_FSTYPES ?= "wic.xz wic.bmap wic.xz.sha256sum"
AGL_DEFAULT_IMAGE_FSTYPES:qemuall ?= "${@bb.utils.contains('AGL_FEATURES', 'AGLCI', 'ext4.xz', 'ext4', d)}"
AGL_DEFAULT_IMAGE_FSTYPES:append:netboot = " ${@bb.utils.contains('AGL_FEATURES', 'AGLCI', 'ext4.xz', 'ext4', d)}"
AGL_DEFAULT_INITRAMFS_FSTYPES ?= "ext4.gz"

# DEFAULT IMAGE_FSTYPES for AGL (no - BSPs should not set this)
#
IMAGE_FSTYPES = "${AGL_DEFAULT_IMAGE_FSTYPES} ${AGL_EXTRA_IMAGE_FSTYPES}"
INITRAMFS_FSTYPES = "${AGL_DEFAULT_INITRAMFS_FSTYPES} ${AGL_EXTRA_INITRAMFS_FSTYPES}"
#
```

## meta-app-framework/conf/layer.conf
```bitbake
# We have a conf and classes directory, add to BBPATH
BBPATH .= ":${LAYERDIR}"

# We have recipes-* directories, add to BBFILES
BBFILES += "${LAYERDIR}/recipes-*/*/*.bb \
	${LAYERDIR}/recipes-*/*/*.bbappend"

BBFILE_COLLECTIONS += "app-framework"
BBFILE_PATTERN_app-framework = "^${LAYERDIR}/"
BBFILE_PRIORITY_app-framework = "70"

LAYERSERIES_COMPAT_app-framework = "dunfell"

# dependency: meta-oe
LAYERDEPENDS_app-framework  = "openembedded-layer"
# dependency: meta-security
LAYERDEPENDS_app-framework += "security"

# AGL core layer is an optional requirement
LAYERRECOMMENDS_app-framework += "aglcore"
LAYERRECOMMENDS_app-framework += "qt5-layer"

BBFILES_DYNAMIC += " \
    qt5-layer:${LAYERDIR}/dynamic-layers/meta-qt5/*/*/*.bb \
    qt5-layer:${LAYERDIR}/dynamic-layers/meta-qt5/*/*/*.bbappend \
    aglcore:${LAYERDIR}/dynamic-layers/meta-agl-core/*/*/*.bb \
    aglcore:${LAYERDIR}/dynamic-layers/meta-agl-core/*/*/*.bbappend \
"


# bug in meta-security
BBMASK += "packagegroup-core-security-ptest\.bb"
#BBMASK += "meta-security/recipes-mac/smack/smack-test_1.0.bb
```
