## ci/kconfig/Kconfig
```kconfig
# SPDX-License-Identifier: MIT
mainmenu "AGL kas configuration (local/interactive use only - CI uses ci/build-matrix.yaml)"

source "ci/kconfig/Kconfig.machines"
source "ci/kconfig/Kconfig.features"
```
